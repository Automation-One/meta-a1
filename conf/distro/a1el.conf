## conf/distro/a1el.conf
```bitbake
# Use O.S. Systems Embedded Linux as base
require conf/distro/oel.conf

### Automation One Embedded Linux specific settings

DISTRO = "a1el"
DISTRO_NAME = "Automation One Embedded Linux"

TARGET_VENDOR = "-a1el"
SDK_VENDOR = "-a1elsdk"
SDK_VERSION := "${@'${DISTRO_VERSION}'.replace('snapshot-${DATE}','snapshot')}"

OEL_EXTRA_DISTRO_FEATURES = "\
    bluetooth \
    ext2 \
    usbhost \
    vfat \
    wifi \
    virtualization \
"
```

## conf/layer.conf
```bitbake
# We have a conf and classes directory, add to BBPATH
BBPATH .= ":${LAYERDIR}"

# We have recipes-* directories, add to BBFILES
BBFILES += "${LAYERDIR}/recipes-*/*/*.bb \
            ${LAYERDIR}/recipes-*/*/*.bbappend"

BBFILE_COLLECTIONS += "meta-a1"
BBFILE_PATTERN_meta-a1 = "^${LAYERDIR}/"
BBFILE_PRIORITY_meta-a1 = "6"

LAYERDEPENDS_meta-a1 = "core freescale-layer"
LAYERSERIES_COMPAT_meta-a1 = "dunfell"
```

## conf/machine/imx6ull-a1-r1.conf
```bitbake
#@TYPE: Machine
#@NAME: Automation One i.MX6ULL Rev. 1 board
#@SOC: i.MX6UL/i.MX6ULL
#@DESCRIPTION: Machine configuration for Automation One i.MX6ULL Revision 1
#@MAINTAINER: O.S. Systems Software <contato@ossystems.com.br>

MACHINEOVERRIDES =. "mx6:mx6ul:"

include conf/machine/include/imx-base.inc
include conf/machine/include/tune-cortexa7.inc

USE_VT = "0"
SERIAL_CONSOLES = "115200;ttymxc3"

PREFERRED_PROVIDER_virtual/kernel ?= "linux-a1"
PREFERRED_PROVIDER_u-boot ?= "u-boot-a1"
PREFERRED_PROVIDER_virtual/bootloader ?= "u-boot-a1"

KERNEL_CLASSES ?= " kernel-fitimage "
KERNEL_IMAGETYPES ?= "fitImage"
KERNEL_DEVICETREE ?= "imx6ull-a1-gw.dtb"
KBUILD_DEFCONFIG ?= "a1_defconfig"

PREFERRED_PROVIDER_u-boot-fw-utils ?= "libubootenv"
PREFERRED_PROVIDER_u-boot-default-script ?= "u-boot-updatehub-script"

UBOOT_CONFIG = "kontron-mx6ul"
UBOOT_CONFIG[kontron-mx6ul] = "kontron_mx6ul_defconfig"

SPL_BINARY = "SPL"
UBOOT_ENTRYPOINT = "0x81000000"
UBOOT_MAKE_TARGET = "u-boot.img SPL"
UBOOT_SUFFIX = "img"

# Deploy only fitimage and dtb files in /boot
RDEPENDS_${KERNEL_PACKAGE_NAME}-base = ""
MACHINE_ESSENTIAL_EXTRA_RDEPENDS += "kernel-image-fitimage"
MACHINE_EXTRA_RRECOMMENDS = "\
    kernel-modules \
    linux-firmware-imx-sdma-imx6q \
    linux-firmware-rs9113 \
"

MACHINE_FEATURES_BACKFILL_remove = "qemu-usermode"
MACHINE_FEATURES = "usbgadget usbhost 3g"

IMAGE_CLASSES += "image_types_512m-ubifs-nand"

## NAND 512MB
MKUBIFS_ARGS = "-F -m 4096 -e 253952 -c 950 -x favor_lzo -X 5"
MKUBIFS_ARGS_INTERNAL = "-F -m 4096 -e 253952 -c 100 -x favor_lzo -X 5"
UBINIZE_ARGS = "-m 4096 -p 262144 -s 4096"
UBI_VOLNAME = "spi-nand0"

# The Wic settings is only for installer-nand image
IMAGE_BOOT_FILES = "boot-installer-nand.scr-${MACHINE};boot.scr"
WKS_FILE_DEPENDS = "u-boot-installer-nand-script"
WKS_FILES ?= "imx-uboot-spl-bootpart.wks.in"
```
